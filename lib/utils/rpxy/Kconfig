## lib/utils/rpxy/Kconfig
```kconfig
# SPDX-License-Identifier: BSD-2-Clause

menu "RPXY Device Support"

config FDT_RPXY
	bool "FDT based RPXY drivers"
	depends on FDT
	default n

if FDT_RPXY

config FDT_RPXY_MBOX
	bool "FDT RPXY mailbox client driver"
	depends on FDT_MAILBOX
	default n

endif

endmenu
```
